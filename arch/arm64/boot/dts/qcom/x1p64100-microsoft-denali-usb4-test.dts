// SPDX-License-Identifier: BSD-3-Clause
/* Isolated X1P LCD USB4 activation experiment. */

/dts-v1/;

#include "x1p64100-microsoft-denali.dts"

&usb4_hr0 {
	status = "okay";
	/*
	 * Activation is deferred to `echo 1 > .../uc_activate` so the UC
	 * boots only after the Type-C stack has brought the ps883x retimer
	 * out of reset (first plug event). Its init-time sideband discovery
	 * needs a live target. Add qcom,nhi-activate for boot-time activation.
	 */
};

/ {
	reserved-memory {
		/* Survives warm reboot: pstore console for freeze diagnosis. */
		ramoops@bffc00000 {
			compatible = "ramoops";
			reg = <0xb 0xffc00000 0x0 0x400000>;
			no-map;
			record-size = <0x40000>;
			console-size = <0x40000>;
			pmsg-size = <0x20000>;
			ecc-size = <0>;
		};
	};
};
